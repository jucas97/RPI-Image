## meta-rpi-adaptation/conf/distro/rpi-adaptation.conf
```bitbake
INIT_MANAGER="systemd"

MACHINE_ESSENTIAL_EXTRA_RDEPENDS += "kernel-module-food_disp"
```

## meta-rpi-adaptation/conf/layer.conf
```bitbake
# BBPATH - Path to layers with configuration files and classes
BBPATH =. "${LAYERDIR}:"

# BBFILES - list of recipes, which may be identified through python glob operator
BBFILES += "${LAYERDIR}/recipes-*/*/*.bb \
            ${LAYERDIR}/recipes-*/*/*.bbappend"

# BBFILE_COLLECTIONS - Append the configured name layer
BBFILE_COLLECTIONS += "rpi-adaptation"
# BBFILE_PATTERN - 
BBFILE_PATTERN_rpi-adaptation = "^${LAYERDIR}/"
# BBFILE_PRIORITY - Specify the recipes priority
BBFILE_PRIORITY_rpi-adaptation = "5"

# LAYERVERSION - Specifies the layer version
LAYERVERSION_rpi-adaptation = "1"
# LAYERSERIES_COMPAT - OpenEmbeddded-Core compatability
LAYERSERIES_COMPAT_rpi-adaptation = "dunfell"
# LAYERDEPENDS - Layer dependency
LAYERDEPENDS_rpi-adaptation = "core"
```

## meta-rpi-adaptation/conf/machine/linux-rpi.inc
```bitbake
#@TYPE: Machine
#@NAME: RaspberryPi 2 Development Board Extension
#@DESCRIPTION: DTB overlay specification for the RaspberryPi 2

RPI_KERNEL_DEVICETREE_OVERLAYS_append = "overlays/gpio-line-names-bcm2709.dtbo"
```
